## main/Kconfig.projbuild
```kconfig
choice CM_BUILD_EXAMPLE
    prompt "Examples"
    help
        Build the Clockstar firmware or one of the examples.
    default CM_BUILD_FIRMWARE

    config CM_BUILD_FIRMWARE
        bool "Clockstar firmware"
    config CM_EXAMPLE_IMU
        bool "IMU and sensor fusion example"
    config CM_EXAMPLE_ANCS
        bool "ANCS example"
    config CM_EXAMPLE_BANGLE
        bool "BangleJS protocol example"
    config CM_EXAMPLE_GATT_SERVER
        bool "GATT server example"
    config CM_EXAMPLE_GYRO
        bool "Gyroscope and accelerometer example"
    config CM_TEST_SLEEP
        bool "Light sleep with BT test"
    config CM_TEST_SLEEP_WAKE
        bool "Light sleep with wake on GPIO"
    config CM_TEST_SLEEP_WAKE_INT
        bool "Light sleep with GPIO interrupt and wake on same pin"
endchoice
```
